## meta-rpi-panel/conf/layer.conf
```bitbake
# We have a conf and classes directory, add to BBPATH
BBPATH .= ":${LAYERDIR}"

# We have recipes-* directories, add to BBFILES
BBFILES += "${LAYERDIR}/recipes-*/*/*.bb \
            ${LAYERDIR}/recipes-*/*/*.bbappend"

BBFILE_COLLECTIONS += "meta-rpi-panel"
BBFILE_PATTERN_meta-rpi-panel = "^${LAYERDIR}/"
BBFILE_PRIORITY_meta-rpi-panel = "7"

LAYERDEPENDS_meta-rpi-panel = "core"
LAYERSERIES_COMPAT_meta-rpi-panel = "dunfell"
```
